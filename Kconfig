## Kconfig
```kconfig
config RAW_HID
    bool "Enable Raw HID"
    depends on !ZMK_SPLIT || ZMK_SPLIT_ROLE_CENTRAL
    imply USB_DEVICE_HID

config RAW_HID_USAGE_PAGE
    hex "Raw HID Usage Page"
    default 0xFF60

config RAW_HID_USAGE
    hex "Raw HID Usage"
    default 0x61

config RAW_HID_REPORT_SIZE
    int "Raw HID Report Size"
    default 32

config RAW_HID_DEVICE
    string "Raw HID Device"
    default "HID_1"

config RAW_HID_ENABLE_RECEIVE
    bool "Enable Raw HID receive path (host -> keyboard)"
    depends on RAW_HID
    default n
    help
      When disabled (default), the keyboard accepts but discards reports sent
      from the host over both USB and BLE. The raw_hid_received_event is not
      raised. This eliminates a class of bugs where listeners would receive
      pointers to transient USB/BT stack buffers. Enable only if you actually
      have a consumer of the receive event.
```
